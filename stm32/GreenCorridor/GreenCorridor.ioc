# file: GreenCorridor.ioc
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Mcu.Family=STM32F1
Mcu.Name=STM32F103C(8-B)Tx
Mcu.Package=LQFP48
NVIC.PriorityGroup=NVIC_PRIORITYGROUP_4
ProjectManager.HeapSize=0x200
ProjectManager.StackSize=0x400
ProjectManager.TargetToolchain=STM32CubeIDE
RCC.APB1Freq_Value=8000000
RCC.APB2Freq_Value=8000000
board=custom

// file: Core/Src/main.c
/* USER CODE BEGIN Header */
/**
  ******************************************************************************
  * @file           : main.c
  * @brief          : Main program body
  ******************************************************************************
  * @attention
  *
  * Copyright (c) 2026 STMicroelectronics.
  * All rights reserved.
  *
  * This software is licensed under terms that can be found in the LICENSE file
  * in the root directory of this software component.
  * If no LICENSE file comes with this software, it is provided AS-IS.
  *
  ******************************************************************************
  */
/* USER CODE END Header */
#include "main.h"
#include "traffic_monitor.h"
#include "ambulance_tracker.h"
#include "route_optimizer.h"
#include "eta_calculator.h"

void SystemClock_Config(void);

int main(void)
{

  /* MCU Configuration--------------------------------------------------------*/

  /* Reset of all peripherals, Initializes the Flash interface and the Systick. */
  HAL_Init();

  /* Configure the system clock */
  SystemClock_Config();

  /* Initialize all configured peripherals */
  /* USER CODE BEGIN 2 */
  TrafficState state;
  TrafficState traffic;

  TrafficMonitor_Init(&state);
  TrafficMonitor_Init(&traffic);

  TrafficMonitor_SetVehicleCount(&state, NODE_A, 35);
  TrafficMonitor_SetVehicleCount(&state, NODE_B, 12);
  TrafficMonitor_SetVehicleCount(&state, NODE_C, 48);
  TrafficMonitor_UpdateDensity(&state);
  TrafficMonitor_PrintReport(&state);

  // Set mixed traffic: B is MEDIUM (90s), C is HIGH (150s), others are LOW (60s)
  TrafficMonitor_SetVehicleCount(&traffic, NODE_B, 12);
  TrafficMonitor_SetVehicleCount(&traffic, NODE_C, 48);
  TrafficMonitor_UpdateDensity(&traffic);

  AmbulanceState ambulance;
  AmbulanceTracker_Init(&ambulance, NODE_A);

  RouteDetails route;
  route.path[0] = NODE_A;
  route.path[1] = NODE_B;
  route.path[2] = NODE_C;
  route.path[3] = NODE_F;
  route.path[4] = NODE_I;
  route.path_length = 5;
  route.total_cost = 4.0f;

  RouteOptimizer_FindPath(&traffic, NODE_A, &route);

  // Print the generated route details
  RouteOptimizer_PrintRoute(&route);

  AmbulanceTracker_Init(&ambulance, NODE_A);

  AmbulanceTracker_SetRoute(&ambulance, &route);

  // Move step-by-step
  AmbulanceTracker_MoveToNext(&ambulance, NODE_B);
  AmbulanceTracker_MoveToNext(&ambulance, NODE_C);
  AmbulanceTracker_MoveToNext(&ambulance, NODE_F);

  // Print status before arrival (at Junction F)
  AmbulanceTracker_PrintStatus(&ambulance);

  // Move to Hospital I (Arrival)
  AmbulanceTracker_MoveToNext(&ambulance, NODE_I);

  // Print status on arrival (Junction I)
  AmbulanceTracker_PrintStatus(&ambulance);

  uint32_t eta = ETACalculator_CalculateETA(&ambulance, &route, &traffic);

  // Print the ETA report
  ETACalculator_PrintETA(eta);
  /* USER CODE END 2 */

  /* Infinite loop */
  while (1)
  {

  }
}

void SystemClock_Config(void)
{
  RCC_OscInitTypeDef RCC_OscInitStruct = {0};
  RCC_ClkInitTypeDef RCC_ClkInitStruct = {0};

  /** Initializes the RCC Oscillators according to the specified parameters
  * in the RCC_OscInitTypeDef structure.
  */
  RCC_OscInitStruct.OscillatorType = RCC_OSCILLATORTYPE_HSI;
  RCC_OscInitStruct.HSIState = RCC_HSI_ON;
  RCC_OscInitStruct.HSICalibrationValue = RCC_HSICALIBRATION_DEFAULT;
  RCC_OscInitStruct.PLL.PLLState = RCC_PLL_NONE;
  if (HAL_RCC_OscConfig(&RCC_OscInitStruct) != HAL_OK)
  {
    Error_Handler();
  }

  /** Initializes the CPU, AHB and APB buses clocks
  */
  RCC_ClkInitStruct.ClockType = RCC_CLOCKTYPE_HCLK|RCC_CLOCKTYPE_SYSCLK
                              |RCC_CLOCKTYPE_PCLK1|RCC_CLOCKTYPE_PCLK2;
  RCC_ClkInitStruct.SYSCLKSource = RCC_SYSCLKSOURCE_HSI;
  RCC_ClkInitStruct.AHBCLKDivider = RCC_SYSCLK_DIV1;
  RCC_ClkInitStruct.APB1CLKDivider = RCC_HCLK_DIV1;
  RCC_ClkInitStruct.APB2CLKDivider = RCC_HCLK_DIV1;

  if (HAL_RCC_ClockConfig(&RCC_ClkInitStruct, FLASH_LATENCY_0) != HAL_OK)
  {
    Error_Handler();
  }
}

void Error_Handler(void)
{
  __disable_irq();
  while (1)
  {
  }
}
